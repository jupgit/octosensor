// SERIAL1 DATA FROM NANO
#define RXD2 16
#define TXD2 17

const byte numChars = 32;
char receivedChars[numChars];   // an array to store the received data
boolean newData = false;

int distanceCM = 0;



// DISPLAY OLED SETUP
 
//#include <SPI.h>
#include <Wire.h>

#include <Adafruit_GFX.h>
#include <Adafruit_SSD1306.h>

#define SCREEN_WIDTH 128 // OLED display width, in pixels
#define SCREEN_HEIGHT 64 // OLED display height, in pixels

// Declaration for an SSD1306 display connected to I2C (SDA, SCL pins)
#define OLED_RESET     4 // Reset pin # (or -1 if sharing Arduino reset pin)
Adafruit_SSD1306 display(SCREEN_WIDTH, SCREEN_HEIGHT, &Wire, OLED_RESET);

int MeterValue = 40;
int hMeter = 65;                      // horizontal center for needle animation
int vMeter = 85;                      // vertical center for needle animation (outside of dislay limits)
int rMeter = 80;                      // length of needle animation or arch of needle travel

// VU meter background mask image:
static const unsigned char PROGMEM VUMeter[] = { 
  0x00, 0x00, 0x00, 0x00, 0x00, 0x00, 0x00, 0x00, 0x00, 0x00, 0x00, 0x00, 0x00, 0x00, 0x00, 0x00,
  0x00, 0x00, 0x00, 0x00, 0x00, 0x00, 0x00, 0x00, 0x00, 0x00, 0x00, 0x00, 0x00, 0x00, 0x00, 0x00,
  0x00, 0x00, 0x00, 0x00, 0x00, 0x00, 0x00, 0x00, 0x00, 0x00, 0x00, 0x00, 0x00, 0x00, 0x00, 0x00,
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  0x00, 0x00, 0x00, 0x00, 0x00, 0x00, 0x00, 0x00, 0x00, 0x00, 0x00, 0x00, 0x00, 0x00, 0x00, 0x00
};





void setup() {
  
    Serial.begin(115200);
    //Serial.println("<Arduino is ready>");
    
    //Serial 2 do ESP32 que recebe do arduino Nano
    //Serial1.begin(115200, SERIAL_8N1, RXD2, TXD2);

/// DISPLAY OLED

  // SSD1306_SWITCHCAPVCC = generate display voltage from 3.3V internally
  if(!display.begin(SSD1306_SWITCHCAPVCC, 0x3C)) { // Address 0x3D for 128x64
    //Serial.println(F("SSD1306 allocation failed"));
    for(;;); // Don't proceed, loop forever
  }

  // Show initial display buffer contents on the screen --
  // the library initializes this with an Adafruit splash screen.
  display.display();
  delay(2000); // Pause for 2 seconds

  // Clear the buffer
  display.clearDisplay();

  //display.invertDisplay(1);

  // Draw a single pixel in white
  display.drawPixel(63, 31, SSD1306_WHITE);

}


/// LOOP //////////////////////////////////////////////////////////////////////////////////////

void loop() { 

    // RECEIVE SENSOR DATA FROM NANO
    recvWithEndMarker();
    readSensorFromNano();

    MeterValue = map(distanceCM, 0, 400, 0, 80);

    //Serial.print(distanceCM);
    //Serial.print("cm / meter = ");
    //Serial.println(MeterValue);
     
    MeterValue = MeterValue - 34;                            // shifts needle to zero position
    display.clearDisplay();                                  // refresh display for next step
    //display.drawBitmap(0, 0, VUMeter, 128, 64, WHITE);       // draws background
    int a1 = (hMeter + (sin(MeterValue / 57.296) * rMeter)); // meter needle horizontal coordinate
    int a2 = (vMeter - (cos(MeterValue / 57.296) * rMeter)); // meter needle vertical coordinate
    display.drawLine(a1, a2, hMeter, vMeter, WHITE);         // draws needle
    display.display();


    delay(10);
}









////////////////////////////////////
////
////     F U N C T I O N S
////
////////////////////////////////////


/// NANO + SENSOR TO ESP32 SERIAL COMMUNICATION FUNCTIONS

/// Used to receive sensor data over Seria11 from Arduino Nano
void recvWithEndMarker() {
    static byte ndx = 0;
    char endMarker = '\n';
    char rc;
   
    while (Serial.available() > 0 && newData == false) {
        rc = Serial.read();

        if (rc != endMarker) {
            receivedChars[ndx] = rc;
            ndx++;
            if (ndx >= numChars) {
                ndx = numChars - 1;
            }
        }
        else {
            receivedChars[ndx] = '\0'; // terminate the string
            ndx = 0;
            newData = true;
        }
    }
}

/// Use to show sensor data over Seria11 from Arduino Nano
void showNewData() {
    if (newData == true) {
        Serial.print("This just in ... ");
        Serial.println(receivedChars);
        newData = false;
    }


}
void readSensorFromNano() {

      if (newData == true) {
        //Serial.println(receivedChars);
        distanceCM = atoi(receivedChars);
        newData = false;

    }


}

/// END OF: NANO + SENSOR TO ESP32 SERIAL COMMUNICATION FUNCTIONS




    
